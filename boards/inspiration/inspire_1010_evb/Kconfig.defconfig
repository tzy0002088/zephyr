## boards/inspiration/inspire_1010_evb/board.yml
```yaml
board:
  name: inspire_1010_evb
  vendor: inspiration
  socs:
  - name: inspire_1010
```

## drivers/serial/Kconfig.inspire_1010
```kconfig
config UART_INSPIRE_1010
	bool "inspire 1010 UART driver"
	default y
	depends on DT_HAS_INSPIRE_ISP_UART_ENABLED
	select SERIAL_HAS_DRIVER
```

## drivers/timer/Kconfig.inspire_1010
```kconfig
# Copyright (c) 2021 NXP
# SPDX-License-Identifier: Apache-2.0

config INSPIRE_1010_GP_TIMER
	bool "Inspire GPT Event timer"
	default y
	depends on DT_HAS_FSL_GP_TIMER_ENABLED
	select TICKLESS_CAPABLE
```

## dts/bindings/serial/inspire,isp-uart.yaml
```yaml
# Copyright (c) 2023-2024 Analog Devices, Inc.
# SPDX-License-Identifier: Apache-2.0

description: Inspiration Uart

include: [uart-controller.yaml, pinctrl-device.yaml]

compatible: "inspire,isp-uart"

properties:
  reg:
    required: true

  current-speed:
    description: |
      Initial baud rate setting for UART. Defaults to standard baudrate of 115200 if not specified.
    default: 115200
```

## dts/bindings/timer/fsl,gp-timer.yaml
```yaml
# Copyright (c) 2022 Kumar Gala <galak@kernel.org>
# SPDX-License-Identifier: Apache-2.0

description: FSL General-Purpose HW Timer

compatible: "fsl,gp-timer"

include: base.yaml

properties:
  reg:
    required: true

  interrupts:
    required: true
```

## soc/inspiration/Kconfig.soc
```kconfig
config SOC_FAMILY_INSPIRE_101X
	bool

config SOC_FAMILY
	default "inspire_101x" if SOC_FAMILY_INSPIRE_101X

rsource "*/Kconfig.soc"
```

## soc/inspiration/inspire_101x/Kconfig
```kconfig
config SOC_SERIES_INSPIRE_101X
    select CPU_CORTEX_A7
    select ARM
    select BUILD_OUTPUT_HEX
    select SOC_EARLY_INIT_HOOK
```

## soc/inspiration/inspire_101x/Kconfig.defconfig
```kconfig
if SOC_SERIES_INSPIRE_101X

config NUM_IRQS
    default 128

config MMU
    default y

config SYS_CLOCK_HW_CYCLES_PER_SEC
	default 1000000

config OUTPUT_DISASSEMBLY
	default y

endif
```

## soc/inspiration/inspire_101x/Kconfig.soc
```kconfig
config SOC_INSPIRE_1010
    bool
    select SOC_SERIES_INSPIRE_101X

config SOC_SERIES_INSPIRE_101X
    bool
    select SOC_FAMILY_INSPIRE_101X

config SOC_SERIES
    default "inspire_101x" if SOC_SERIES_INSPIRE_101X

config SOC
    default "inspire_1010" if SOC_INSPIRE_1010
```

## soc/inspiration/inspire_101x/inspire_1010/Kconfig
```kconfig
config SOC_SERIES_INSPIRE_101X
    bool
    select ARM
    select CPU_CORTEX_A7
    select BUILD_OUTPUT_HEX
    select SOC_EARLY_INIT_HOOK
    select ARM_ARCH_TIMER
```

## soc/inspiration/inspire_101x/inspire_1010/Kconfig.defconfig
```kconfig
if SOC_SERIES_INSPIRE_101X

config NUM_IRQS
    default 64

config MMU
    default y

endif
```

## soc/inspiration/inspire_101x/inspire_1010/Kconfig.soc
```kconfig
config SOC_SERIES_INSPIRE_101X
    select SOC_FAMILY_INSPIRE
    help
        Enable support for inpire 101x soc series

config SOC_INSPIRE_1010
    bool
    select SOC_SERIES_INSPIRE_101X

config SOC
    default "inspire_1010" if SOC_INSPIRE_1010
```

## soc/inspiration/inspire_cm/Kconfig.soc
```kconfig
config SOC_FAMILY_INSPIRE
	bool

config SOC_FAMILY
	default "inspire" if SOC_FAMILY_INSPIRE

rsource "*/Kconfig.soc"
```
